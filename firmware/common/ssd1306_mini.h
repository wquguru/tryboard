// 最小 SSD1306 128x64 驱动 + 5x7 字库，供 oled / weather 等示例共用（只在一个 .c 里包含）。
// 包含前需已包含 driver/i2c_master.h；使用者负责创建设备句柄 oled。
#pragma once
#include <string.h>
#include "driver/i2c_master.h"

static i2c_master_dev_handle_t oled;
static uint8_t fb[128 * 64 / 8];

// 经典 5x7 点阵字库，ASCII 0x20..0x7E，每字 5 列，低位在上
static const uint8_t font5x7[][5] = {
    {0x00,0x00,0x00,0x00,0x00},{0x00,0x00,0x5F,0x00,0x00},{0x00,0x07,0x00,0x07,0x00},{0x14,0x7F,0x14,0x7F,0x14},
    {0x24,0x2A,0x7F,0x2A,0x12},{0x23,0x13,0x08,0x64,0x62},{0x36,0x49,0x55,0x22,0x50},{0x00,0x05,0x03,0x00,0x00},
    {0x00,0x1C,0x22,0x41,0x00},{0x00,0x41,0x22,0x1C,0x00},{0x08,0x2A,0x1C,0x2A,0x08},{0x08,0x08,0x3E,0x08,0x08},
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    {0x00,0x00,0x7F,0x00,0x00},{0x00,0x41,0x36,0x08,0x00},{0x10,0x08,0x08,0x10,0x08},
};

static inline void px(int x, int y, int on)
{
    if (x < 0 || x >= 128 || y < 0 || y >= 64) return;
    if (on) fb[(y / 8) * 128 + x] |= 1 << (y % 8);
    else fb[(y / 8) * 128 + x] &= ~(1 << (y % 8));
}

static inline void text(int x, int y, const char *s, int scale)
{
    for (; *s; s++, x += 6 * scale) {
        int c = (*s < 0x20 || *s > 0x7e) ? '?' : *s;
        for (int col = 0; col < 5; col++)
            for (int row = 0; row < 7; row++)
                if (font5x7[c - 0x20][col] >> row & 1)
                    for (int dx = 0; dx < scale; dx++)
                        for (int dy = 0; dy < scale; dy++) px(x + col * scale + dx, y + row * scale + dy, 1);
    }
}

static inline void rect(int x, int y, int w, int h, int fill)
{
    for (int i = x; i < x + w; i++)
        for (int j = y; j < y + h; j++)
            if (fill || i == x || i == x + w - 1 || j == y || j == y + h - 1) px(i, j, 1);
}

static inline esp_err_t cmds(const uint8_t *c, size_t n)
{
    uint8_t buf[32];
    buf[0] = 0x00; // 控制字节：后面全是命令
    memcpy(buf + 1, c, n);
    return i2c_master_transmit(oled, buf, n + 1, 100);
}

static inline esp_err_t flush(void)
{
    static const uint8_t win[] = {0x21, 0, 127, 0x22, 0, 7};
    ESP_ERROR_CHECK(cmds(win, sizeof win));
    static uint8_t buf[1 + sizeof fb];
    buf[0] = 0x40; // 控制字节：后面全是显存数据
    memcpy(buf + 1, fb, sizeof fb);
    return i2c_master_transmit(oled, buf, sizeof buf, 200);
}

// 标准初始化序列：关显示、时钟、复用率、偏移、起始行、电荷泵、水平寻址、段重映射、COM 反扫、对比度、开显示
static inline esp_err_t ssd1306_init(void)
{
    static const uint8_t init[] = {0xAE, 0xD5, 0x80, 0xA8, 0x3F, 0xD3, 0x00, 0x40, 0x8D, 0x14, 0x20, 0x00,
                                   0xA1, 0xC8, 0xDA, 0x12, 0x81, 0xCF, 0xD9, 0xF1, 0xDB, 0x40, 0xA4, 0xA6, 0xAF};
    return cmds(init, sizeof init);
}
